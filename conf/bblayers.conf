## conf/bblayers.conf
```bitbake
# LAYER_CONF_VERSION is increased each time build/conf/bblayers.conf
# changes incompatibly
LCONF_VERSION = "6"

BBPATH = "${TOPDIR}"
BBFILES ?= ""

BBLAYERS ?= " \
  /var/rpi/poky/meta \
  /var/rpi/poky/meta-yocto \
  /var/rpi/poky/meta-yocto-bsp \
  /var/rpi/rpi-build/sources/meta-raspberrypi \
  /var/rpi/rpi-build/sources/meta-openembedded/meta-oe \
  "
#/var/rpi/rpi-build/sources/meta-angstrom/ \
```
